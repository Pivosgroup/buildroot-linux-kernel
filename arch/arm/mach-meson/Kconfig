## drivers/amlogic/input/Kconfig
```kconfig
#
# Input device configuration
#

menu "Amlogic Input device support"

source "drivers/amlogic/input/irremote/Kconfig"

endmenu
```

## drivers/amlogic/input/touch_screen/Kconfig
```kconfig
#
# Input core configuration
#

config SINTEK_CAPACITIVE_TOUCHSCREEN
	tristate "Sintek capacitive touch panel"
	default n
	help
	  Say Y here if you want to use the Sintek capacitive panel.

	  To compile this driver as a module, choose M here: the
	  module will be called .

config ITK_CAPACITIVE_TOUCHSCREEN
	tristate "ITK capacitive touch panel"
	default n
	help
	  Say Y here if you want to use the ITK capacitive panel.

	  To compile this driver as a module, choose M here: the
	  module will be called .

config EETI_CAPACITIVE_TOUCHSCREEN
	tristate "EETI capacitive touch panel"
	default n
	help
	  Say Y here if you want to use the EETI capacitive panel.

	  To compile this driver as a module, choose M here: the
	  module will be called .

config SIS92XX_CAPACITIVE_TOUCHSCREEN
	tristate "sis92xx capacitive touch panel"
	depends on I2C
	default n
	help
	  Say Y here if you want to use the sis92xx capacitive panel.

	  To compile this driver as a module, choose M here: the
	  module will be called .
	  
config FOCALTECH_CAPACITIVE_TOUCHSCREEN
	tristate "focaltech capacitive touch panel"
	depends on I2C
	default n
	help
	  Say Y here if you want to use the focaltech 5x06 capacitive panel.

	  To compile this driver as a module, choose M here: the
	  module will be called .

config SITRONIX_CAPACITIVE_TOUCHSCREEN
	tristate "SITRONIX capacitive touch panel"
	depends on I2C
	default n
	help
	  Say Y here if you want to use the SITRONIX st15xx capacitive panel.

	  To compile this driver as a module, choose M here: the
	  module will be called .
	  
config HX8520_CAPACITIVE_TOUCHSCREEN
	tristate "HX8520 capacitive touch panel"
	depends on I2C
	default n
	help
	  Say Y here if you want to use the HX8520 capacitive panel.

	  To compile this driver as a module, choose M here: the
	  module will be called .
	  
config RAYDIUM_CAPACITIVE_TOUCHSCREEN
	tristate "Raydium capacitive touch panel"
	depends on I2C
	default n
	help
	  Say Y here if you want to use the Raydium capacitive panel.

	  To compile this driver as a module, choose M here: the
	  module will be called .
	  
config GOODIX_CAPACITIVE_TOUCHSCREEN
	tristate "Goodix capacitive touch panel"
	depends on I2C
	default n
	help
	  Say Y here if you want to use the Goodix capacitive panel.

	  To compile this driver as a module, choose M here: the
	  module will be called .
config UOR7X5X_RESISTIVE_TOUCHSCREEN
	tristate "UOR7X5X resistive touch panel"
	default n
	help
	  Say Y here if you want to use the UOR7X5X resistive panel.

	  To compile this driver as a module, choose M here: the
	  module will be called .  
config UOR6X5X_RESISTIVE_TOUCHSCREEN
	tristate "UOR6X5X resistive touch panel"
	default n
	help
	  Say Y here if you want to use the UOR6X5X resistive panel.

config PIXCIR_CAPACITIVE_TOUCHSCREEN
	tristate "pixcir capacitive touch panel"
	depends on I2C
	default n
	help
	  Say Y here if you want to use the pixcir capacitive panel.

	  To compile this driver as a module, choose M here: the
	  module will be called .  
```

## drivers/amlogic/light_sensor/Kconfig
```kconfig
menu "Amlogic Light Sensor Support"

config LS_GL3526
	bool "ADC Light Sensor - GL3526"
	select INPUT_POLLDEV
	default n
	---help---
	  This module adds support for adc light sensor gl3526

endmenu
```

## drivers/amlogic/modem/Kconfig
```kconfig
menu "Amlogic intenal modem  Support"

config AMLOGIC_MODEM
	bool "Amlogic intenal modem  support"
	select IN_3G_SUPPLY
	default n
	help
	  Say Y here if you want to use the amlogic intenal modem management.

config AMLOGIC_MODEM_PM
	bool "Amlogic intenal modem power on/off when system suspend/resume"
	depends on AMLOGIC_MODEM
	help
	  Say Y here if you want to Amlogic intenal modem power on/off 
	  when system suspend/resume.

	  If unsure, say N.
	  
endmenu
```

## drivers/amlogic/nand/Kconfig
```kconfig
#
# Amlogic NAND device configuration
#

menu "AMLOGIC NAND Flash support"

config AM_NAND
	bool "Amlogic NAND FLASH SUPPORT"
	    depends on ARCH_MESON
	default y
        select MTD_NAND 
	    select MTD_PARTITIONS
        select MTD_BLOCK
        select MTD_CHAR
        help
		This is Meson_M1 nand suport

config AML_NAND_ENV
	bool "use aml nand env (/dev/nand_env)"
	    depends on AM_NAND
	default y
config AML_NFTL
	tristate "Amlogic NFTL (NAND Flash Translation Layer) support"
	depends on AM_NAND
	default m
        help
		This is aml nftl suport
endmenu
```

## drivers/amlogic/ppmgr/Kconfig
```kconfig
#
# Post Process Manager device configuration
#

menu "AMLOGIC Post Process Manager driver"

config POST_PROCESS_MANAGER
    tristate "AMLOGIC Post Process Manager driver"
    default n
	help
	  Select to enable AMLOGIC Post Process Manager driver.

config MIX_FREE_SCALE
    tristate "AMLOGIC mix free scale"
    depends on  POST_PROCESS_MANAGER
    default n
	help
	  Select mix free scale mode in  ppmgr module.
endmenu
```

## drivers/amlogic/sound/Kconfig
```kconfig
# ALSA ARC drivers

menu "Amlogic ALSA Audio devices"

config	SND_AML
	tristate "Amlogic Audio driver"
	select	SOUND
	select	SND
	select	SND_PCM_OSS
	help
		"ALSA driver for AML"
	
endmenu	
```

## drivers/amlogic/spi/Kconfig
```kconfig
#
# Sensor device configuration
#

menu "AMLOGIC SPI Hardware bus support"


config AMLOGIC_SPI_HW_MASTER
	tristate "AMLOGIC SPI HARDWARE BUS MASTER SUPPORT"

  select SPI
	help
		This is amlogic spi bus Hardware master suport
		This driver can also be built as a module.  If so, the module
		will be called spi-apollo.
	  
endmenu
```

## drivers/amlogic/uart/Kconfig
```kconfig
choice
        prompt "Amlogic UART Support"
        default AM_UART_WITH_S_CORE

config AM_UART_WITH_S_CORE
        bool "with serial core"
        depends on ARCH_MESON || ARCH_MESON2
        select SERIAL_CORE
        select SERIAL_CORE_CONSOLE
        help
           hardware uart

config AM_UART_WITHOUT_S_CORE
        bool "without serial core"
        depends on ARCH_MESON || ARCH_MESON2
        select SERIAL_CORE
        select SERIAL_CORE_CONSOLE
        help
           hardware uart

endchoice

choice
        prompt "---SET UART0 PORT"
        default AM_UART0_SET_PORT_A

config AM_UART0_SET_PORT_A
        bool "uart port A"
        depends on ARCH_MESON && AM_UART_WITH_S_CORE
        select SERIAL_CORE
        select SERIAL_CORE_CONSOLE
        help
           hardware uart

config AM_UART0_SET_PORT_B
        bool "uart port B"
        depends on ARCH_MESON && AM_UART_WITH_S_CORE
        select SERIAL_CORE
        select SERIAL_CORE_CONSOLE
        help
           hardware uart

endchoice
```

## drivers/amlogic/ueventmsg/Kconfig
```kconfig
#
# AMLOGIC uevent message configuration
#

menu "Amlogic Uevent Message Support"

config AML_UEVENT_MSG
	bool "Amlogic Uevent Message"
	default y
	help
		Amlogic Uevent Message Sending

endmenu
```

## drivers/amlogic/usb/Kconfig
```kconfig
menu "Amlogic USB Support"

config USB_DWC_OTG_HCD
        bool "Amloigc usb host controler dwc_otg support"

        help
           usb dwc_otg

config USB_HOST_ELECT_TEST
				bool "USB High speed electric test support"
				depends on USB_DWC_OTG_HCD
				default y
				help
					Enable this config to support USB High speed electric test.
					
config DWC_USB_NO_SOF
				bool "Disable DWC OTG USB SOF ISR"
				depends on USB_DWC_OTG_HCD
				default y
				help
					[y]Enalbe this config to disable DWC OTG USB SOF interrupt handler.
						 Then the handler is moved to timer.
					[n]Disable this config to let SOF handler in interrupt.
					Don't change this if you don't know what it is.
					
config DWC_USB_NAK_IN_TIMER
				bool "Disable DWC OTG USB NAK ISR"
				depends on USB_DWC_OTG_HCD
				default n
				help
					[y]Enalbe this config to disable DWC OTG USB NAK interrupt handler.
						 The handler is moved to timer.
					[n]Disable this config to let NAK handler in interrupt.
					Don't change this if you don't know what it is.
endmenu
```

## drivers/amlogic/vibrator/Kconfig
```kconfig
menu "Amlogic Vibrator Support"

source "drivers/amlogic/vibrator/haptic/Kconfig"

endmenu
```

## sound/soc/aml/Kconfig
```kconfig
config SND_AML_SOC
	tristate "soc audio for AMLogic Ssystem-on-system"
	depends on ARCH_MESON || ARCH_A1H || ARM
	help
	  Say Y or M if you want to add support for codecs attached to
	  the AMLogic I2S interface. You will also need
	  to select the audio interfaces to support below.
	  
config SND_AML_M1
	tristate "M1 evaluation board with internel audio dac"
	depends on SND_AML_SOC


config SND_AML_M1_MID_WM8900
	tristate "AML6236 MID board with WM8900"
	depends on SND_AML_SOC
        select SND_SOC_WM8900 if SND_AML_M1_MID_WM8900

config SND_AML_M1_ARMDEV_WM8900
	tristate "AML8726M ARM Dev board with WM8900"
	depends on SND_AML_SOC
		select SND_SOC_WM8900 if SND_AML_M1_ARMDEV_WM8900
	
config SND_AML_M1_MID_RT5621
	tristate "AML8726M MID board with RT5621"
	depends on SND_AML_SOC
		select SND_SOC_RT5621 if SND_AML_M1_MID_RT5621
		
config SND_AML_M1_MID_CS42L52
	tristate "AML8726M MID board with CS42L52"
	depends on SND_AML_SOC
        select SND_SOC_CS42L52 if SND_AML_M1_MID_CS42L52
```
