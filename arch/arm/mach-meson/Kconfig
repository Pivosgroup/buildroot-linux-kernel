## arch/arm/mach-meson/Kconfig
```kconfig
menu "Meson platform type"
	depends on ARCH_MESON

config MACH_MESON_6236M
	bool "Support M1 6236(MODE:MBOX728) platform(machid=2951)"
	help
	  Include support for the AMLOGIC M1 6236M Emulation Baseboard platform.

config MACH_MESON_8626M
	bool "Support M1 8626(MBOX_8626M1_V1.0) platform(machid=2952)"
	help
	  Include support for the AMLOGIC M1 8626M Emulation Baseboard platform.

config MACH_MESON_6236M_SH
	bool "Support M1 6236(dpf_aml6236-m_innolux8_skt_v1) platform(machid=2953)"
	help
	  Include support for the AMLOGIC M1 6236M Emulation Baseboard platform.

config MACH_MESON_8626M_SH
	bool "Support M1 8626(mbx_aml8626-m_skt_v1) platform(machid=2954)"
	help
	  Include support for the AMLOGIC M1 8626M Emulation Baseboard platform.

config MACH_MESON_8226M
	bool "Support M1 8226(dvbc_8226m1_v1.0) platform(machid=2955)"
	help
	  Include support for the AMLOGIC M1 8226M Emulation Baseboard platform.

config MACH_MESON_8726M
	bool "Support M1 8726(mid_8726m1_v1.0) platform(machid=2956)"
	help
	  Include support for the AMLOGIC M1 8726M Emulation Baseboard platform.

config MACH_MESON_8726M_ARM
	bool "Support M1 8726(for arm board) platform(machid=2956)"
	help
	  Include support for the AMLOGIC M1 8726M Emulation Baseboard platform.

choice
	prompt "---Select Nand Flash Type---"
	depends on MACH_MESON_8726M_ARM
	default REFC01_4K_PAGE

config REFC01_4K_PAGE
	bool "4K Page Size of Nand Flash"

config REFC01_2K_PAGE
	bool "2K Page Size of Nand Flash"

endchoice
	  	  
config MESON_CLOCK_TICK_RATE
    int "Clock Tick Rate"
	default 25000000

endmenu
```

## arch/arm/mach-meson2/Kconfig
```kconfig
menu "Meson2 platform type"
	depends on ARCH_MESON2

config MACH_MESON2_7366M
	bool "Support M2 7366 (machid=2956)"
	help
	  Include support for the AMLOGIC M2 7366M Emulation Baseboard platform.

config MESON_CLOCK_TICK_RATE
    int "Clock Tick Rate"
	default 25000000

endmenu
```

## drivers/amlogic/amports/Kconfig
```kconfig
#
# AMLOGIC streaming device configuration
#

menu "AMLOGIC AV Streaming devices"

menuconfig AM_DEINTERLACE
	bool "AMLOGIC Deinterlace"
	default y
	select AM_CANVAS
	help
	  Driver for deinterlace.
	  
if AM_DEINTERLACE
config AM_DEINTERLACE_SD_ONLY
	bool "AMLOGIC Deinterlace SD only"
	default n
endif

config AM_VIDEO
	bool "AMLOGIC Video management"
	default y
	select AM_CANVAS
	select AM_PTSMGR
	select AM_TIMESYNC
	select AM_DEINTERLACE
	help
	  Driver for video display.

config AM_PTSSERVER
	bool

config AM_VDEC_MPEG12
	tristate "AMLOGIC MPEG1/2 Video Decoder"
	default y
	select AM_VIDEO
	select AM_PTSSERVER
	help
	  Driver for mpeg1/2 video decoder.

config AM_VDEC_MPEG4
	tristate "AMLOGIC MPEG4 Video Decoder"
	default y
	select AM_VIDEO
	select AM_PTSSERVER
	help
	  Driver for mpeg4 video decoder.

config AM_VDEC_VC1
	tristate "AMLOGIC VC1 Video Decoder"
	default y
	select AM_VIDEO
	select AM_PTSSERVER
	help
	  Driver for vc1 video decoder.

config AM_VDEC_H264
	tristate "AMLOGIC H264 Video Decoder"
	default y
	select AM_VIDEO
	select AM_PTSSERVER
	help
	  Driver for h264 video decoder.

config AM_VDEC_MJPEG
	tristate "AMLOGIC Motion JPEG Video Decoder"
	default y
	select AM_VIDEO
	select AM_PTSSERVER
	help
	  Driver for motion jpeg video decoder.

config AM_VDEC_REAL
	tristate "AMLOGIC Real Video Decoder"
    default y
    select AM_VIDEO
	select AM_PTSSERVER
    help
      Driver for real video decoder.

config AM_JPEGDEC
    tristate "AMLOGIC HW jpeg decoder"
    default y
    select AM_VIDEO
	select AM_PTSSERVER
	help
	  Select to enable HW jpeg decoder.

config AM_TIMESYNC
	bool "AMLOGIC Time sync driver"
	default y
	help
	  AV sync and play rate control management.

config AM_STREAMING
	bool "AMLOGIC AV Streaming support"
	default y
	select AM_PTSSERVER
	help
	  Driver for the AV streaming ports.

config AM_SUBTITLE
	bool	"AMLOGIC SubTitle support"
	default y
	help 
		Internal Sub Title support driver

endmenu
```

## drivers/amlogic/audiodsp/Kconfig
```kconfig
#
# audio dsp  configuration
#
menu "Amlogic audio dsp process "

config  AML_AUDIO_DSP
	tristate  "audio dsp control support "
	default m
	help  
		aupport the audio dsp ;
		

endmenu	
```

## drivers/amlogic/bluetooth/Kconfig
```kconfig
menu "Amlogic BT Device Support"

config BT_DEVICE
	bool "4329 BT Device support"
	depends on BT && RFKILL
	select BACKLIGHT_CLASS_DEVICE
	default n
	help
	  Say Y here if you want to use the BT device.

menuconfig SDIO_MARVELL_NH387_BT
	bool "Marvell nh387 bt support"
	depends on SD_MMC && SDIO_MARVELL_NH387_WIFI
	select BT_HCIBTSDIO
	select WEXT_SPY
	default n
		---help---
	  This module adds support for bt adapters based on
	  Marvell nh387 chipset.
if SDIO_MARVELL_NH387_BT		  
config MRVLNH387_PXA3XX_DMA_ALIGN
	depends on SDIO_MARVELL_NH387_BT
	bool "PXA3XX DMA alignment"
	default y
		---help---
	  PXA3XX DMA alignment.
endif	  
endmenu
```

## drivers/amlogic/deinterlace/Kconfig
```kconfig
#
# Deinterlace driver configuration
#

menu "AMLOGIC Deinterlace driver"

config DEINTERLACE
    tristate "DEINTERLACE driver"
    default y
	help
	  Select to enable AMLOGIC DEINTERLACE driver.
endmenu
```

## drivers/amlogic/demod/Kconfig
```kconfig
menu "AMLOGIC DEMOD Support"

config AM_DEMOD
	bool "Amlogic Demod Support"
	default n
	help
		m1 internal Demod DVB-T/C suport
endmenu
```

## drivers/amlogic/display/osd/Kconfig
```kconfig
#
# Frame buffer configuration
#
menu "Amlogic osd module"

config FB_AM
	tristate "Amlogic osd support"
	depends on FB
	select FB_CFB_FILLRECT
	select FB_CFB_COPYAREA
	select FB_CFB_IMAGEBLIT
	select AM_CANVAS
	help
	  This is the frame buffer device driver.

config FB_OSD2_ENABLE
	bool "osd2 layer enable"
	default y
	depends on  FB_AM
	help  
		if enable osd2 then we will have two OSD op layer

config FB_OSD2_CURSOR
	bool "Android OSD2 cursor support"
	depends on FB_OSD2_ENABLE
	default n
	help
		Enables support for a mouse cursor using OSD2.
config FB_OSD1_DEFAULT_BITS_PER_PIXEL
	depends on FB_AM
	int "default OSD1 BPP"
	range 16  32
	default  16
	---help---
	 The default osd1 color depth.
config FB_OSD2_DEFAULT_BITS_PER_PIXEL
	depends on FB_AM && FB_OSD2_ENABLE
	int "default OSD2 BPP"
	range 16  32
	default  32
	---help---
	 The default osd2 color depth.
config FB_OSD1_DEFAULT_WIDTH
	depends on FB_AM
	int "Default OSD1 width"
	range 1 4096
	default 720
	---help---
	  The default osd1/fb0 width. Does not affect ability to change width using fbset or FBIOPUT ioctl.

config FB_OSD1_DEFAULT_HEIGHT
	depends on FB_AM
	int "Default OSD1 height"
	range 1 4096
	default 480
	---help---
	  The default osd1/fb0 height. Does not affect ability to change height using fbset or FBIOPUT ioctl.

config FB_OSD1_DEFAULT_WIDTH_VIRTUAL
	depends on FB_AM
	int "Default OSD1 virtual width"
	range FB_OSD1_DEFAULT_WIDTH 4096
	default 720
	---help---
	  The default osd1/fb0 virtual width. Does not affect ability to change width using fbset or FBIOPUT ioctl.

config FB_OSD1_DEFAULT_HEIGHT_VIRTUAL
	depends on FB_AM
	int "Default OSD1 virtual height"
	range FB_OSD1_DEFAULT_HEIGHT 4096
	default 480
	---help---
	  The default osd1/fb0 virtual height. Does not affect ability to change height using fbset or FBIOPUT ioctl.

config FB_OSD2_DEFAULT_WIDTH
	depends on FB_AM && FB_OSD2_ENABLE
	int "Default OSD2 width"
	range 1 4096
	default 720
	---help---
	  The default osd2/fb1 width. Does not affect ability to change width using fbset or FBIOPUT ioctl.

config FB_OSD2_DEFAULT_HEIGHT
	depends on FB_AM && FB_OSD2_ENABLE
	int "Default OSD2 height"
	range 1 4096
	default 480
	---help---
	  The default osd2/fb1 height. Does not affect ability to change height using fbset or FBIOPUT ioctl.

config FB_OSD2_DEFAULT_WIDTH_VIRTUAL
	depends on FB_AM && FB_OSD2_ENABLE
	int "Default OSD2 virtual width"
	range FB_OSD2_DEFAULT_WIDTH 4096
	default 720
	---help---
	  The default osd2/fb1 virtual width. Does not affect ability to change width using fbset or FBIOPUT ioctl.

config FB_OSD2_DEFAULT_HEIGHT_VIRTUAL
	depends on FB_AM && FB_OSD2_ENABLE
	int "Default OSD2 virtual height"
	range FB_OSD2_DEFAULT_HEIGHT 4096
	default 480
	---help---
	  The default osd2/fb1 virtual height. Does not affect ability to change height using fbset or FBIOPUT ioctl.

config FB_MULTI_OUTPUT_MODE
	bool "Muti output mode enable"
	depends on FB_AM
	default n
	help
		Enables support for multi-outputmode in OSD1.
		

config FB_OSD1_480_DEFAULT_WIDTH
	depends on FB_MULTI_OUTPUT_MODE
	int "Default OSD1 width (MBX480)"
	range 1 4096
	default 680
	---help---
	  The default osd1/fb0 width. Does not affect ability to change width using fbset or FBIOPUT ioctl.

config FB_OSD1_480_DEFAULT_HEIGHT
	depends on FB_MULTI_OUTPUT_MODE
	int "Default OSD1 height(MBX480)"
	range 1 4096
	default 460
	---help---
	  The default osd1/fb0 height. Does not affect ability to change height using fbset or FBIOPUT ioctl.

config FB_OSD1_480_DEFAULT_WIDTH_VIRTUAL
	depends on FB_MULTI_OUTPUT_MODE
	int "Default OSD1 virtual width(MBX480)"
	range FB_OSD1_480_DEFAULT_WIDTH 4096
	default 920
	---help---
	  The default osd1/fb0 virtual width. Does not affect ability to change width using fbset or FBIOPUT ioctl.

config FB_OSD1_480_DEFAULT_HEIGHT_VIRTUAL
	depends on FB_MULTI_OUTPUT_MODE
	int "Default OSD1 virtual height(MBX480)"
	range FB_OSD1_480_DEFAULT_HEIGHT 4096
	default 920
	---help---
	  The default osd1/fb0 virtual height. Does not affect ability to change height using fbset or FBIOPUT ioctl.
	  
config FB_OSD1_576_DEFAULT_WIDTH
	depends on FB_MULTI_OUTPUT_MODE
	int "Default OSD1 width (MBX576)"
	range 1 4096
	default 680
	---help---
	  The default osd1/fb0 width. Does not affect ability to change width using fbset or FBIOPUT ioctl.

config FB_OSD1_576_DEFAULT_HEIGHT
	depends on FB_MULTI_OUTPUT_MODE
	int "Default OSD1 height(MBX576)"
	range 1 4096
	default 556
	---help---
	  The default osd1/fb0 height. Does not affect ability to change height using fbset or FBIOPUT ioctl.

config FB_OSD1_576_DEFAULT_WIDTH_VIRTUAL
	depends on FB_MULTI_OUTPUT_MODE
	int "Default OSD1 virtual width(MBX576)"
	range FB_OSD1_576_DEFAULT_WIDTH 4096
	default 680
	---help---
	  The default osd1/fb0 virtual width. Does not affect ability to change width using fbset or FBIOPUT ioctl.

config FB_OSD1_576_DEFAULT_HEIGHT_VIRTUAL
	depends on FB_MULTI_OUTPUT_MODE
	int "Default OSD1 virtual height(MBX576)"
	range FB_OSD1_576_DEFAULT_HEIGHT 4096
	default 1112
	---help---
	  The default osd1/fb0 virtual height. Does not affect ability to change height using fbset or FBIOPUT ioctl.

config FB_OSD1_720_DEFAULT_WIDTH
	depends on FB_MULTI_OUTPUT_MODE
	int "Default OSD1 width (MBX720)"
	range 1 4096
	default 1240
	---help---
	  The default osd1/fb0 width. Does not affect ability to change width using fbset or FBIOPUT ioctl.

config FB_OSD1_720_DEFAULT_HEIGHT
	depends on FB_MULTI_OUTPUT_MODE
	int "Default OSD1 height(MBX720)"
	range 1 4096
	default 690
	---help---
	  The default osd1/fb0 height. Does not affect ability to change height using fbset or FBIOPUT ioctl.

config FB_OSD1_720_DEFAULT_WIDTH_VIRTUAL
	depends on FB_MULTI_OUTPUT_MODE
	int "Default OSD1 virtual width(MBX720)"
	range FB_OSD1_720_DEFAULT_WIDTH 4096
	default 1240
	---help---
	  The default osd1/fb0 virtual width. Does not affect ability to change width using fbset or FBIOPUT ioctl.

config FB_OSD1_720_DEFAULT_HEIGHT_VIRTUAL
	depends on FB_MULTI_OUTPUT_MODE
	int "Default OSD1 virtual height(MBX720)"
	range FB_OSD1_720_DEFAULT_HEIGHT 4096
	default 1380
	---help---
	  The default osd1/fb0 virtual height. Does not affect ability to change height using fbset or FBIOPUT ioctl.	  	  

config FB_OSD1_1080_DEFAULT_WIDTH
	depends on FB_MULTI_OUTPUT_MODE
	int "Default OSD1 width (MBX1080)"
	range 1 4096
	default 1880
	---help---
	  The default osd1/fb0 width. Does not affect ability to change width using fbset or FBIOPUT ioctl.

config FB_OSD1_1080_DEFAULT_HEIGHT
	depends on FB_MULTI_OUTPUT_MODE
	int "Default OSD1 height(MBX1080)"
	range 1 4096
	default 1060
	---help---
	  The default osd1/fb0 height. Does not affect ability to change height using fbset or FBIOPUT ioctl.

config FB_OSD1_1080_DEFAULT_WIDTH_VIRTUAL
	depends on FB_MULTI_OUTPUT_MODE
	int "Default OSD1 virtual width(MBX1080)"
	range FB_OSD1_1080_DEFAULT_WIDTH 4096
	default 1880
	---help---
	  The default osd1/fb0 virtual width. Does not affect ability to change width using fbset or FBIOPUT ioctl.

config FB_OSD1_1080_DEFAULT_HEIGHT_VIRTUAL
	depends on FB_MULTI_OUTPUT_MODE
	int "Default OSD1 virtual height(MBX1080)"
	range FB_OSD1_1080_DEFAULT_HEIGHT 4096
	default 2120
	---help---
	  The default osd1/fb0 virtual height. Does not affect ability to change height using fbset or FBIOPUT ioctl.	  
endmenu	
```

## drivers/amlogic/display/vout/Kconfig
```kconfig
#
# Video output configuration
#
menu "Amlogic video output module"

config AM_TV_OUTPUT
	tristate "TV output"
	default y
	help  
		tv output module
		
config AM_TCON_OUTPUT
	tristate "LCD output" 
	help  
		LCD output module

config AML_TCON_T13
	tristate "T13 panel driver"
	depends on  AM_TCON_OUTPUT
	help  
		T13 LCD panel module

config AML_TCON_ML10
	tristate "ML10 panel driver"
	depends on  AM_TCON_OUTPUT
	help  
		ML10 LCD panel module

config AML_TCON_W10
	tristate "W10 panel driver"
	depends on  AM_TCON_OUTPUT
	help  
		W10 LCD panel module

config AML_TCON_W7
	tristate "W7 panel driver"
	depends on  AM_TCON_OUTPUT
	help  
		W7 LCD panel module
		
config AML_TCON_W7CPT
	tristate "W7CPT panel driver"
	depends on  AM_TCON_OUTPUT
	help  
		W7CPT LCD panel module
		
config AML_TCON_W7NEW
	tristate "W7NEW panel driver"
	depends on  AM_TCON_OUTPUT
	help  
		W7NEW LCD panel module
		
config AML_TCON_W8
	tristate "W8 panel driver"
	depends on  AM_TCON_OUTPUT
	help  
		W8 LCD panel module

config AML_TCON_P7
	tristate "P7 panel driver"
	depends on  AM_TCON_OUTPUT
	help  
		P7 LCD panel module

config AML_TCON_K7
	tristate "K7 panel driver"
	depends on  AM_TCON_OUTPUT
	help  
		K7 LCD panel module
			
config AML_TCON_C7
	tristate "C7 panel driver"
	depends on  AM_TCON_OUTPUT
	help  
		C7 LCD panel module	
		
config AML_TCON_K8
	tristate "K8 panel driver"
	depends on  AM_TCON_OUTPUT
	help  
		K8 LCD panel module
		
config AML_TCON_G7
	tristate "G7 panel driver"
	depends on  AM_TCON_OUTPUT
	help  
		G7 LCD panel module
		
config AML_TCON_A18
	tristate "A18 panel driver"
	depends on  AM_TCON_OUTPUT
	help  
		A18 LCD panel module

config AML_TCON_A19
	tristate "A19 panel driver"
	depends on  AM_TCON_OUTPUT
	help  
		A19 LCD panel module

config AML_TCON_R10
	tristate "R10 panel driver"
	depends on  AM_TCON_OUTPUT
	help  
		R10 LCD panel module

config AML_TCON_REFB13
	tristate "REFB13 panel driver"
	depends on  AM_TCON_OUTPUT
	help  
		REFB13 LCD panel module

config AML_TCON_REFB14
	tristate "REFB14 panel driver"
	depends on  AM_TCON_OUTPUT
	help  
		REFB14 LCD panel module	

config AML_TCON_T10
	tristate "T10 panel driver"
	depends on  AM_TCON_OUTPUT
	help  
		T10 LCD panel module		
		
config AML_TCON_REFB17
	tristate "REFB17 panel driver"
	depends on  AM_TCON_OUTPUT
	help  
		T13 LCD panel module	
config AML_TCON_P10
	tristate "P10 panel driver"
	depends on  AM_TCON_OUTPUT
	help  
		P10 LCD panel module
		
endmenu
	
```

## drivers/amlogic/gps/Kconfig
```kconfig
menu "Amlogic GPS Support"

config AR1520_GPS
	bool "Atheros 1520 gps support"
	depends on SERIAL_CORE
	---help---
	  This module adds support for gps adapters based on
	  Atheros 1520 chipset.
	  
endmenu
```

## drivers/amlogic/hdmi/Kconfig
```kconfig
menu "Amlogic HDMI Support"


config AML_HDMI_TX
        tristate "HDMI output enable"
        default y
        help  
                hdmi output enable,It should be enalbe if board have hdmi out interface

if AM_DEINTERLACE
config AML_HDMI_TX_HDCP
        tristate "HDMITX hdcp enable"
        default n
        help  
                hdmitx hdcp enable,It should be enalbe if board have hdmitx hdcp key
endif        
endmenu
```
